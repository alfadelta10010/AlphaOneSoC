## sw/linux/recipe/defconfig
```kconfig
BR2_riscv=y
BR2_riscv_custom=y
BR2_RISCV_ISA_RVM=y
BR2_RISCV_ISA_RVA=y
BR2_RISCV_ISA_RVC=y
BR2_RISCV_32=y
# BR2_RISCV_USE_MMU is not set
BR2_PTHREADS_NONE=y
# BR2_UCLIBC_INSTALL_UTILS is not set
BR2_TARGET_OPTIMIZATION="-Os"
BR2_TARGET_LDFLAGS="-s"
BR2_BACKUP_SITE="http://sources.buildroot.net"
BR2_GLOBAL_PATCH_DIR="board/qemu/riscv32-virt/nommu/patches"
BR2_TARGET_GENERIC_ISSUE="AlphaOneSoC NOMMU Linux"
# BR2_TARGET_ENABLE_ROOT_LOGIN is not set
# BR2_TARGET_GENERIC_GETTY is not set
BR2_ROOTFS_OVERLAY="board/alpha/overlay"
BR2_LINUX_KERNEL=y
BR2_LINUX_KERNEL_CUSTOM_VERSION=y
BR2_LINUX_KERNEL_CUSTOM_VERSION_VALUE="6.8-rc1"
BR2_LINUX_KERNEL_USE_CUSTOM_CONFIG=y
BR2_LINUX_KERNEL_CUSTOM_CONFIG_FILE="board/alpha/linux.config"
BR2_PACKAGE_BUSYBOX_CONFIG="board/alpha/busybox.config"
# BR2_PACKAGE_IFUPDOWN_SCRIPTS is not set
# BR2_PACKAGE_URANDOM_SCRIPTS is not set
BR2_TARGET_ROOTFS_INITRAMFS=y
# BR2_TARGET_ROOTFS_TAR is not set
```

## sw/nuttx/overlay/boards/risc-v/qemu-rv/rv-virt/configs/alphaone/defconfig
```kconfig
# AlphaOneSoC: RV32IMAC flat (no MMU), console on the polled UART, nsh.
CONFIG_ARCH="risc-v"
CONFIG_ARCH_BOARD="rv-virt"
CONFIG_ARCH_BOARD_QEMU_RV_VIRT=y
CONFIG_ARCH_CHIP="qemu-rv"
CONFIG_ARCH_CHIP_QEMU_RV32=y
CONFIG_ARCH_CHIP_QEMU_RV=y
CONFIG_ARCH_CHIP_QEMU_RV_ISA_A=y
CONFIG_ARCH_CHIP_QEMU_RV_ISA_C=y
CONFIG_ARCH_CHIP_QEMU_RV_ISA_M=y
CONFIG_ARCH_IDLE_CUSTOM=y
CONFIG_ARCH_INTERRUPTSTACK=2048
CONFIG_ARCH_RISCV=y
CONFIG_BOARDCTL_POWEROFF=y
CONFIG_BOARD_LOOPSPERMSEC=6366
CONFIG_BUILTIN=y
CONFIG_DEBUG_FULLOPT=y
CONFIG_DEBUG_SYMBOLS=y
CONFIG_ELF=y
CONFIG_EXAMPLES_HELLO=y
CONFIG_FS_PROCFS=y
CONFIG_FS_TMPFS=y
CONFIG_IDLETHREAD_STACKSIZE=2048
CONFIG_INIT_ENTRYPOINT="nsh_main"
CONFIG_LIBC_ENVPATH=y
CONFIG_LIBC_EXECFUNCS=y
CONFIG_LIBC_PERROR_STDOUT=y
CONFIG_LIBC_STRERROR=y
CONFIG_LIBM=y
CONFIG_NFILE_DESCRIPTORS_PER_BLOCK=6
CONFIG_NSH_ARCHINIT=y
CONFIG_NSH_BUILTIN_APPS=y
CONFIG_NSH_FILEIOSIZE=512
CONFIG_NSH_READLINE=y
CONFIG_PATH_INITIAL="/system/bin"
CONFIG_RAM_SIZE=16711680
CONFIG_RAM_START=0x80000000
CONFIG_READLINE_CMD_HISTORY=y
CONFIG_RR_INTERVAL=200
CONFIG_SCHED_WAITPID=y
CONFIG_SERIAL_TERMIOS=y
CONFIG_START_MONTH=11
CONFIG_START_YEAR=2026
CONFIG_SYMTAB_ORDEREDBYNAME=y
CONFIG_SYSTEM_NSH=y
CONFIG_USEC_PER_TICK=10000
# CONFIG_ARCH_FPU is not set
CONFIG_ARCH_STACKDUMP=y
```

## sw/zephyr/zalpha/boards/others/alphaone/alphaone_defconfig
```kconfig
CONFIG_CONSOLE=y
CONFIG_SERIAL=y
CONFIG_UART_CONSOLE=y
CONFIG_XIP=n
CONFIG_RISCV_PMP=n
CONFIG_SYS_CLOCK_TICKS_PER_SEC=100
CONFIG_POWEROFF=y
CONFIG_MINIMAL_LIBC=y
```

## sw/zephyr/zalpha/boards/others/alphaone/board.yml
```yaml
board:
  name: alphaone
  full_name: AlphaOneSoC (FyraCore RV32IMAC)
  vendor: others
  socs:
    - name: alphaone_soc
```

## sw/zephyr/zalpha/soc/alphaone/alphaone_soc/Kconfig
```kconfig
config SOC_ALPHAONE_SOC
	select HAS_POWEROFF
	select INCLUDE_RESET_VECTOR
	select RISCV
	select RISCV_PRIVILEGED
	select SERIAL_HAS_DRIVER
	select RISCV_ISA_RV32I
	select RISCV_ISA_EXT_M
	select RISCV_ISA_EXT_A
	select RISCV_ISA_EXT_C
	select RISCV_ISA_EXT_ZICSR
	select RISCV_ISA_EXT_ZIFENCEI
	select RISCV_SOC_HAS_GP_RELATIVE_ADDRESSING
```

## sw/zephyr/zalpha/soc/alphaone/alphaone_soc/Kconfig.soc
```kconfig
config SOC_ALPHAONE_SOC
	bool

config SOC
	default "alphaone_soc" if SOC_ALPHAONE_SOC
```
